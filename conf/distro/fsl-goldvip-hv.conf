## conf/distro/fsl-goldvip-hv.conf
```bitbake
require conf/distro/include/fsl-goldvip-base.inc

DISTRO = "fsl-goldvip-hv"

# Required features for GoldVIP distro with hypervisor support
DISTRO_FEATURES:append = " xen"
XEN_EXAMPLE = "xen-examples-goldvip"
```

## conf/distro/fsl-goldvip.conf
```bitbake
require conf/distro/fsl-auto.conf

# Required features for goldvip
DISTRO_FEATURES:append = " xen"
DISTRO_FEATURES:append = " pfe-slave"
DISTRO_FEATURES:append = " bridge_utils"
XEN_EXAMPLE = "xen-examples-goldvip"

# Optional features for goldvip
DISTRO_FEATURES:append = " goldvip-bootloader"
DISTRO_FEATURES:append = " goldvip-crypto"
DISTRO_FEATURES:append = " goldvip-containerization seccomp"
DISTRO_FEATURES:append = " goldvip-dds"
DISTRO_FEATURES:append = " goldvip-gateway"
DISTRO_FEATURES:append = " goldvip-ml"
DISTRO_FEATURES:append = " goldvip-ota"
DISTRO_FEATURES:append = " goldvip-benchmark"
DISTRO_FEATURES:append = " goldvip-telemetry-server"
DISTRO_FEATURES:append = " goldvip-adaptive-autosar"
DISTRO_FEATURES:append = " optee"

SJA1110_UC_FW ?= "${GOLDVIP_BINARIES_DIR}/sja1110_uc.bin"
SJA1110_SWITCH_FW ?= "${GOLDVIP_BINARIES_DIR}/sja1110_switch.bin"

DISTRO_FEATURES:remove = " systemd"
DISTRO_FEATURES_BACKFILL_CONSIDERED:remove = " sysvinit"
VIRTUAL-RUNTIME_init_manager = "sysvinit"
VIRTUAL-RUNTIME_initscripts = "initscripts"
```

## conf/machine/goldvip-s32g-domu.conf
```bitbake
# Recipe which creates the file system for the DomU
GOLDVIP_DOMU_ROOTFS_SOURCE ?= "fsl-image-goldvip-domu"

# Set path for the file system created by the previous recipe
SDCARD_ROOTFS_EXTRA1_FILE = "${DEPLOY_DIR_IMAGE}/${GOLDVIP_DOMU_ROOTFS_SOURCE}-${MACHINE}.ext4"
SDCARD_ROOTFS_EXTRA1_SIZE := "$(du --apparent-size --block-size=1024 $(readlink -f ${SDCARD_ROOTFS_EXTRA1_FILE}) | awk '{print $1}')"
```

## conf/machine/goldvip-s32g274ardb2-ota.conf
```bitbake
# Include a second partition for Linux VM update.
SDCARD_ROOTFS_EXTRA2_FILE = "$(dd if=/dev/zero of=${DEPLOY_DIR_IMAGE}/empty.ext4 bs=1M count=$(expr ${SDCARD_ROOTFS_EXTRA1_SIZE} \/ 1024) && echo ${DEPLOY_DIR_IMAGE}/empty.ext4)"
SDCARD_ROOTFS_EXTRA2_SIZE := "${SDCARD_ROOTFS_EXTRA1_SIZE}"
```

## conf/machine/s32g274ardb2goldvip.conf
```bitbake
# Copyright 2023-2024 NXP

# The GoldVIP version of the conf file just resets to the normal conf
# file name, so that we do not have to change compatibility settings
# all over the place.

MACHINE="s32g274ardb2"

require conf/machine/s32g274ardb2.conf
require conf/machine/include/s32g-pfems.inc
```

## conf/machine/s32g399ardb3goldvip.conf
```bitbake
# The GoldVIP version of the conf file just resets to the normal conf
# file name, so that we do not have to change compatibility settings
# all over the place.

MACHINE="s32g399ardb3"
KERNEL_DEVICETREE = "freescale/s32g399a-rdb3-pfems.dtb"

require conf/machine/s32g399ardb3.conf
```
